## firmware/main/Kconfig.projbuild
```kconfig
menu "Pixel Snap Voice"

    choice PSV_BOARD
        prompt "Target board"
        default PSV_BOARD_KORVO2
        help
            Korvo-2 / ESP-BOX for Phase 0. Custom is the slim Pixelsnap PCB.

        config PSV_BOARD_KORVO2
            bool "ESP32-S3-Korvo-2 (ES8311 play, ES7210 capture)"
        config PSV_BOARD_ESP_BOX
            bool "ESP-BOX / ESP-BOX-3 (ES8311 play, ES7210 capture)"
        config PSV_BOARD_CUSTOM
            bool "Custom pixel-snap-voice PCB (ES8311 duplex, codec is I2S master)"
    endchoice

    config PSV_USB_MSC
        bool "TinyUSB mass storage on the SD volume"
        default y
        help
            When a USB host enumerates, recording and playback stop and the
            SD card is exposed as a drive. Phase 0 can disable this and use
            an SD reader instead.

    config PSV_SD_MOUNT_POINT
        string "SD VFS mount point"
        default "/sdcard"

    config PSV_WIFI_SHARE
        bool "Wi-Fi SoftAP file share"
        default y
        help
            Recorder makes its own WPA2 network and serves /recordings over
            HTTP (browser play/download) and read-only WebDAV. The radio
            stays off until the share gesture. Bluetooth stays off.

    config PSV_WIFI_SSID
        string "SoftAP SSID"
        default "PixelSnapVoice"
        depends on PSV_WIFI_SHARE

    config PSV_WIFI_PASS
        string "SoftAP WPA2 password (8+ characters)"
        default "voicenote1"
        depends on PSV_WIFI_SHARE

    config PSV_WIFI_SHARE_DOUBLE
        bool "Double-press toggles Wi-Fi share"
        default y if PSV_BOARD_CUSTOM
        default n
        depends on PSV_WIFI_SHARE
        help
            On the custom board this is the default (no on-device play).
            Enable on Korvo-2 to prove the file page on that board's antenna.
            Copy-paste overlay: firmware/sdkconfig.korvo_wifi_share (MSC off).

endmenu
```
